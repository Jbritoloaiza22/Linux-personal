## meta-mylayer/conf/distro/Zavala_Distro.conf
```bitbake
DISTRO = "Zavala_Distro"
DISTRO_NAME = "ZavalaDistro"
DISTRO_VERSION = "1.0"
DISTRO_FEATURES += "systemd"
```

## meta-mylayer/conf/layer.conf
```bitbake
# The configuration and classes directory is appended to BBPATH
BBPATH .= ":${LAYERDIR}"

# The recipes for the layers are appended to BBFILES
BBFILES += "${LAYERDIR}/recipes-*/*/*.bb ${LAYERDIR}/recipes-*/*/*.bbappend"

# The BBFILE_COLLECTIONS variable is then appended with the layer name
BBFILE_COLLECTIONS += "mylayer"
BBFILE_PATTERN_meta-mylayer = "^${LAYERDIR}/"
# The BBFILE_PRIORITY variable the assigns a priority to the layer
BBFILE_PRIORITY_meta-mylayer = "1"

# This should only be incremented on significant changes that will
# cause compatibility issues with other layers
LAYERVERSION_meta-mylayer = "1"

LAYERDEPENDS_meta-mylayer = "core"

LAYERSERIES_COMPAT_meta-mylayer = "kirkstone"
```
